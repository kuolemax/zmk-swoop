/*
 * Copyright (c) 2022 Duccio Breschi
 *
 * SPDX-License-Identifier: MIT
 */

#include "swoop.dtsi"

&kscan0 {
    diode-direction = "col2row";
    col-gpios
        = <&pro_micro 18 (GPIO_ACTIVE_HIGH)> // COL0 B1 D15
        , <&pro_micro 15 (GPIO_ACTIVE_HIGH)> // COL1 F7 A0/D18
        , <&pro_micro 14 (GPIO_ACTIVE_HIGH)> // COL2 F6 A1/D19
        , <&pro_micro 16 (GPIO_ACTIVE_HIGH)> // COL3 F5 A2/D20
        , <&pro_micro 10 (GPIO_ACTIVE_HIGH)> // COL4 F4 A3/D21
    ;
    row-gpios
        = <&pro_micro 6 (GPIO_ACTIVE_HIGH | GPIO_PULL_DOWN)> // ROW0 D4 A6/D4
        , <&pro_micro 7 (GPIO_ACTIVE_HIGH | GPIO_PULL_DOWN)> // ROW1 C6 D5
        , <&pro_micro 8 (GPIO_ACTIVE_HIGH | GPIO_PULL_DOWN)> // ROW2 D7 A7/D6
        , <&pro_micro 9 (GPIO_ACTIVE_HIGH | GPIO_PULL_DOWN)> // ROW3 E6 D7
    ;
};

&left_encoder {
    status = "okay";
};
